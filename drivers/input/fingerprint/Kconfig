## drivers/input/fingerprint/Kconfig
```kconfig
#
# Fingerprint driver configuration
#
menuconfig INPUT_FINGERPRINT
	bool "Fingerprints"
	help
	  Say Y here, and a list of supported fingerprints will be displayed.
	  This option doesn't affect the kernel.

	  If unsure, say Y.

if INPUT_FINGERPRINT

source "drivers/input/fingerprint/fingerprint_detect/Kconfig"

config INPUT_FINGERPRINT_FPC1020
	tristate "FPC1020 Fingerprint Driver"
	depends on SPI_MASTER
	help
	  Say Y here if you have a FPC1020 Fingerprint.

	  If unsure, say N.

source "drivers/input/fingerprint/goodix/Kconfig"

endif
```

## drivers/input/fingerprint/fingerprint_detect/Kconfig
```kconfig
#
# Fingerprint Detect driver configuration
#

config INPUT_FINGERPRINT_DETECT
	tristate "Fingerprint Detect Driver"
	depends on SPI_MASTER
	help
	  Say Y here if you have a dependency on Fingerprint Detect.

	  If unsure, say N.
```

## drivers/input/fingerprint/goodix/Kconfig
```kconfig
#
# Goodix fingerprint sensor driver configuration
#

config INPUT_FINGERPRINT_GOODIX
	tristate "Goodix Fingerprint Driver"
	depends on SPI_MASTER
	help
	  Say Y here if you have a Goodix Fingerprint.

	  If unsure, say N.
```

## drivers/platform/oneplus/Kconfig
```kconfig
menu "OnePlus specific device drivers"
	depends on ARCH_QCOM

config BOARD_ONEPLUS5
	bool "OnePlus5 device support"
	depends on ARCH_MSM8998
	help
	 Say 'y' here to include OnePlus5 only modifications.

endmenu
```

## sound/soc/codecs/tfa9891/Kconfig
```kconfig
config SND_SOC_TFA9891
	tristate "NXP TFA9891 Amplifier Driver"
	help
	  Say Y here if you have a NXP TFA9891 Amplifier.

	  If unsure, say N.
```
